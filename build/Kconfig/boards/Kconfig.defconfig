## build/Kconfig/boards/Kconfig.defconfig
```kconfig
# Load Zephyr board defconfig descriptions.
osource "D:/Downloads/nordictest/sdk/zephyr/boards/nordic/nrf21540dk/Kconfig.defconfig"
```

## build/ex_02d_rx_sniff/Kconfig/boards/Kconfig.nrf21540dk
```kconfig
# Load board Kconfig descriptions.
osource "D:/Downloads/nordictest/sdk/zephyr/boards/nordic/nrf21540dk/Kconfig.nrf21540dk"
```

## build_2/Kconfig/boards/Kconfig.sysbuild
```kconfig
# Load Sysbuild board Kconfig descriptions.
osource "D:/Downloads/nordictest/sdk/zephyr/boards/nordic/nrf21540dk/Kconfig.sysbuild"
```
